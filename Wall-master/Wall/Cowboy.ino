/*===========================================================================================================*/
/*Игра ковбой
*/
void cowboy() {
  chooseTime();

  while (!flag) {
    checkTimer();
  }

  if (flag) {
    gong();
  }

  while (!flagInterrupt) {};

}
/*===========================================================================================================*/
/*Выбиарет случайное время в диапазоне 1-6 сек
   Запоминает текущее время
*/
void chooseTime() {

  timer = Random(1000, 6000);
  currentTime = millis();
}
/*===========================================================================================================*/
/*
   Провереяет прошло ли время таймера
   Если прошло то издает звук гонга
   делает флаг 1

*/

void checkTimer() {
  if (millis - currentTime > timer) {
    gong();
    flag = true;
  }
}
/*===========================================================================================================*/
void gong() {
  /*Проигрывает звук гонга*/

}
/*===========================================================================================================*/
/*Функция обработки 1 группы прерывания
   Если была нажата кнопка 1 группы прерываний
   и если флаг == 1 (после звука гонга)
   То победа 1 игрока
   Если флаг != 1 то игрок 1 проигрывает

*/
void ISR_Handler_1() {

  detachInterrupt(digitalPinToInterrupt (ISR_1));
  detachInterrupt(digitalPinToInterrupt (ISR_2));
  delay(20);
  if (isBtn1Pressed()) {
    if (flag) {
      win(1);
    }
    else {
      loose(1);
    }
  }
}
/*===========================================================================================================*/
/*Функция обработки 1 группы прерывания
    Если была нажата кнопка 2 группы прерываний
    и если флаг == 1 (после звука гонга)
    То победа 2 игрока
    Если флаг != 1 то игрок 2 проигрывает
*/
void ISR_Handler_2() {

  detachInterrupt(digitalPinToInterrupt (ISR_1));
  detachInterrupt(digitalPinToInterrupt (ISR_2));
  delay(20);
  if (isBtn2Pressed()) {
    if (flag) {
      win(2);
    }
    else {
      loose(2);
    }
  }
}
/*===========================================================================================================*/
/*Если была нажата какая-либо кнопка 1 группы
  то вернет true иначе false*/
boolean isBtn1Pressed() {
  for (byte i = 0; i < 10; i++) {
    if (digitalRead(btn[i] == HIGH)) {
      return true;
    }
  }
  return false;
}
/*===========================================================================================================*/
/*Если была нажата какая-либо кнопка 2 группы
  то вернет true иначе false*/

boolean isBtn2Pressed() {
  for (byte i = 10; i < 20; i++) {
    if (digitalRead(btn[i] == HIGH)) {
      return true;
    }
  }
  return false;
}
/*===========================================================================================================*/
void win(byte player) {
}
/*===========================================================================================================*/
void loose(byte p){
  }
